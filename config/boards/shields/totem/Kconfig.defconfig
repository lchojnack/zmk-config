## config/boards/shields/totem/Kconfig.defconfig
```kconfig
# Copyright (c) 2022 The ZMK Contributors
# SPDX-License-Identifier: MIT

if SHIELD_TOTEM_DONGLE

config ZMK_KEYBOARD_NAME
    default "TOTEM"

config ZMK_SPLIT_ROLE_CENTRAL
    default y

config ZMK_USB
    default y

endif

if SHIELD_TOTEM_LEFT || SHIELD_TOTEM_RIGHT || SHIELD_TOTEM_DONGLE || SHIELD_TOTEM_TRACKBALL

config ZMK_SPLIT
    default y

endif
```

## config/west.yml
```yaml
manifest:
  remotes:
    - name: lchojnack
      url-base: https://github.com/lchojnack
    - name: caksoylar
      url-base: https://github.com/caksoylar
    - name: badjeff
      url-base: https://github.com/badjeff/
    - name: efogdev
      url-base: https://github.com/efogdev
    - name: nuovotaka
      url-base: https://github.com/nuovotaka
  projects:
    - name: zmk
      remote: lchojnack
      # totem-dongle @ 2026-08-15 - fork of zmkfirmware/zmk main 6e2ef41e with
      # PR #3458, PR #3382 and the no-host-wake fix on top. See README.
      revision: ae6cbff805c17383196d26920f67df203f1ebdfa
      import: app/west.yml
    - name: zmk-rgbled-widget
      remote: caksoylar
      # main @ 2026-07-09
      revision: e6b467792a1dabef8cfa5c9fd26bfefc9c16662b
    - name: zmk-pmw3610-driver
      remote: efogdev
      # zephyr-4.1 @ 2026-04-17
      revision: 38105b4f09d6d5b94ef5a3073428719e3c356af1
    - name: zmk-input-processor-report-rate-limit
      remote: badjeff
      # main @ 2026-03-08
      revision: b056cb135525933743e2627150fb390f9d4b2461
    - name: zmk-behavior-battery-percentage-printer
      remote: badjeff
      # main @ 2025-11-17
      revision: e111cbc6ac66caaa157daeb58eda3c8e2b43153a
    - name: zmk-pointing-acceleration-alpha
      remote: nuovotaka
      # main @ 2025-09-09 - alpha module, governs pointer acceleration
      revision: 780dfcd6b796063367893ff41e233773e12fb07c
  self:
    path: config
```
